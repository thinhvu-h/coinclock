## main/Kconfig.projbuild
```kconfig
menu "CoinClock Configuration"

    config DEBUG_ENABLE
        bool "debug enable"
        default y
        help
            Enable or disable debug.

	config RESET_PROVISIONED
		bool
		default y
		prompt "Reset provisioned status of the device"
		help
			This erases the NVS to reset provisioned status of the device on every reboot.
			Provisioned status is determined by the Wi-Fi STA configuration, saved on the NVS.
	
	choice API_SOURCE
		prompt "choice API source"
		default COIN_CU_API
		config COIN_CU_API
            bool "Load coincu api"
		config COIN_GECKO_BTC_USDT_API
            bool "Load coingecko api - Bitcoin (BTC) - USD"
        config COIN_GECKO_LFW_USDT_API
            bool "Load coingecko api - Legends of Fantasy War (LFW) - USD"
		config COIN_GECKO_AXS_USDT_API
            bool "Load coingecko api - Axie Infinity (AXS) - USD"
    endchoice
	
	config COIN_CU_API_WEB_URL
        string "Manual coin API"
        default "https://api.coincu.com/v1/public/markets/pair/BTC?limit=1&tag=spot"
        depends on COIN_CU_API
        help
            Manual config COIN_API.
			example 1: https://api.coincu.com/v1/public/markets/pair/BTC?limit=1&tag=spot
			example 2: https://api.coingecko.com/api/v3/simple/price?ids=legends-of-fantasy-war&vs_currencies=usd
	
	config COIN_CU_API_WEB_SERVER
        string "Manual WEB_SERVER"
        default "api.coincu.com"
        depends on COIN_CU_API
        help
            Manual config WEB_SERVER.
			example 1: api.coincu.com
			example 2: api.coingecko.com
	
	config COIN_CU_API_WEB_COMMAND
        string "Manual coin API"
        default "/v1/public/markets/pair/BTC?limit=1&tag=spot"
        depends on COIN_CU_API
        help
            Manual config WEB_COMMAND.
			example 1: /v1/public/markets/pair/BTC?limit=1&tag=spot
			example 2: /api/v3/simple/price?ids=legends-of-fantasy-war&vs_currencies=usd

	config COIN_GECKO_AXS_USDT_API_WEB_URL
        string "Manual coin API"
        default "https://api.coingecko.com/api/v3/simple/price?ids=axie-infinity&vs_currencies=usd"
        depends on COIN_GECKO_AXS_USDT_API
        help
            Manual config COIN_API.
			example 1: https://api.coincu.com/v1/public/markets/pair/BTC?limit=1&tag=spot
			example 2: https://api.coingecko.com/api/v3/simple/price?ids=legends-of-fantasy-war&vs_currencies=usd
	
	config COIN_GECKO_AXS_USDT_API_WEB_SERVER
        string "Manual WEB_SERVER"
        default "api.coingecko.com"
        depends on COIN_GECKO_AXS_USDT_API
        help
            Manual config WEB_SERVER.
			example 1: api.coincu.com
			example 2: api.coingecko.com
	
	config COIN_GECKO_AXS_USDT_API_WEB_COMMAND
        string "Manual coin API"
        default "/api/v3/simple/price?ids=axie-infinity&vs_currencies=usd"
        depends on COIN_GECKO_AXS_USDT_API
        help
            Manual config WEB_COMMAND.
			example 1: /v1/public/markets/pair/BTC?limit=1&tag=spot
			example 2: /api/v3/simple/price?ids=legends-of-fantasy-war&vs_currencies=usd

	config COIN_GECKO_LFW_USDT_API_WEB_URL
        string "Manual coin API"
        default "https://api.coingecko.com/api/v3/simple/price?ids=legends-of-fantasy-war&vs_currencies=usd"
        depends on COIN_GECKO_LFW_USDT_API
        help
            Manual config COIN_API.
			example 1: https://api.coincu.com/v1/public/markets/pair/BTC?limit=1&tag=spot
			example 2: https://api.coingecko.com/api/v3/simple/price?ids=legends-of-fantasy-war&vs_currencies=usd
	
	config COIN_GECKO_LFW_USDT_API_WEB_SERVER
        string "Manual WEB_SERVER"
        default "api.coingecko.com"
        depends on COIN_GECKO_LFW_USDT_API
        help
            Manual config WEB_SERVER.
			example 1: api.coincu.com
			example 2: api.coingecko.com
	
	config COIN_GECKO_LFW_USDT_API_WEB_COMMAND
        string "Manual coin API"
        default "/api/v3/simple/price?ids=legends-of-fantasy-war&vs_currencies=usd"
        depends on COIN_GECKO_LFW_USDT_API
        help
            Manual config WEB_COMMAND.
			example 1: /v1/public/markets/pair/BTC?limit=1&tag=spot
			example 2: /api/v3/simple/price?ids=legends-of-fantasy-war&vs_currencies=usd
	
	config COIN_GECKO_BTC_USDT_API_WEB_URL
        string "Manual coin API"
        default "https://api.coingecko.com/api/v3/simple/price?ids=bitcoin&vs_currencies=usd"
        depends on COIN_GECKO_BTC_USDT_API
        help
            Manual config COIN_API.
			example 1: https://api.coincu.com/v1/public/markets/pair/BTC?limit=1&tag=spot
			example 2: https://api.coingecko.com/api/v3/simple/price?ids=legends-of-fantasy-war&vs_currencies=usd
	
	config COIN_GECKO_BTC_USDT_API_WEB_SERVER
        string "Manual WEB_SERVER"
        default "api.coingecko.com"
        depends on COIN_GECKO_BTC_USDT_API
        help
            Manual config WEB_SERVER.
			example 1: api.coincu.com
			example 2: api.coingecko.com
	
	config COIN_GECKO_BTC_USDT_API_WEB_COMMAND
        string "Manual coin API"
        default "/api/v3/simple/price?ids=bitcoin&vs_currencies=usd"
        depends on COIN_GECKO_BTC_USDT_API
        help
            Manual config WEB_COMMAND.
			example 1: /v1/public/markets/pair/BTC?limit=1&tag=spot
			example 2: /api/v3/simple/price?ids=legends-of-fantasy-war&vs_currencies=usd

	config QUICK_WIFI_START
		bool "Quick Setup WiFi enable"
        default n
        help
            Enable or disable debug.
	
	config MANUAL_WIFI_SSID
        string "Manual Wi-Fi SSID"
        default "WIFI_SSID"
        depends on QUICK_WIFI_START
        help
            Manual config SSID (network name) to connect to.

	config MANUAL_WIFI_PASS
        string "Manual Wi-Fi Password"
        default "WIFI_PASS"
		depends on QUICK_WIFI_START
        help
            Manual config Wi-Fi password (WPA or WPA2) for the provisioning.
	    	Can be left blank if the network has no security set.
	
	config ESP_MAXIMUM_RETRY
        int "Maximum retry"
        default 5
        help
            Set the Maximum retry to avoid station reconnecting to the AP unlimited when the AP is really inexistent.

menu "Access Point configuration"

	config AP_SSID
		string "Wifi SSID"
		default "coinclock"
		help
			SSID for the Access Point Wifi network (max 31 chars)

	config AP_PASSWORD
		string "Wifi password"
		default "coinclock@123"
		help
			Password for the Wifi network (if needed)

	config AP_CHANNEL
		int "Wifi channel"
		default 0
		help
			Channel for the Wifi network

	config DEFAULT_AP_IP
		string "Access Point IP Address"
		default "10.10.0.1"
		help
			This is used for the redirection to the captive portal. It is recommended to leave unchanged.

	config DEFAULT_AP_GATEWAY
		string "Access Point IP Gateway"
		default "10.10.0.1"
		help
			This is used for the redirection to the captive portal. It is recommended to leave unchanged.

	config DEFAULT_AP_NETMASK
		string "Access Point Netmask"
		default "255.255.255.0"
		help
			This is used for the redirection to the captive portal. It is recommended to leave unchanged.
	
	choice
		prompt "Authentication mode"
		default WIFI_AUTH_WPA2_PSK
		help
			Authentication mode for the Wifi network
		config WIFI_AUTH_OPEN
			bool "Open"
		config WIFI_AUTH_WEP
			bool "WEP"
		config WIFI_AUTH_WPA_PSK
			bool "WPA-PSK"
		config WIFI_AUTH_WPA2_PSK
			bool "WPA2-PSK"
		config WIFI_AUTH_WPA_WPA2_PSK
			bool "WPA-PSK or WPA2-PSK"
		config WIFI_AUTH_WPA2_ENTERPRISE
			bool "WPA2 Enterprise"			
	endchoice
	
	config AP_HIDE_SSID
		bool "Hide SSID"
		default 0
		help
			Hide SSID
	
	config AP_MAX_CONNECTIONS
		int "Maximum concurrent connections"
		range 1 4
		default 4
		help
			Maximum number of concurrent connections (1-4)
	
	config AP_BEACON_INTERVAL	
		int "Beacon interval (ms)"
		range 100 60000
		default 100
		help
			Beacon interval in ms (100-60000)		
endmenu
endmenu # system setting
```
